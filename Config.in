## Config.in
```kconfig
menu "Anyka AK3918AV100 WebRTC"
	source "$BR2_EXTERNAL_AKWEBRTC_PATH/package/anyka-av100-sdk/Config.in"
	source "$BR2_EXTERNAL_AKWEBRTC_PATH/package/libpeer/Config.in"
	source "$BR2_EXTERNAL_AKWEBRTC_PATH/package/akwebrtc/Config.in"
endmenu
```

## package/akwebrtc/Config.in
```kconfig
config BR2_PACKAGE_AKWEBRTC
	bool "akwebrtc"
	depends on BR2_arm
	depends on BR2_TOOLCHAIN_HAS_THREADS
	depends on !BR2_STATIC_LIBS
	select BR2_PACKAGE_LIBPEER
	select BR2_PACKAGE_ANYKA_AV100_SDK
	help
	  Lightweight WebRTC streamer for Anyka AK3918AV100 cameras:
	  H.264 (+ optional G.711A) from the SoC encoder, sent to browsers
	  with libpeer. Serves its own player page and HTTP signalling.

if BR2_PACKAGE_AKWEBRTC

config BR2_PACKAGE_AKWEBRTC_ARGS
	string "command line options"
	default "-c 1 -W 640 -H 360 -f 15 -b 512 -m 2"
	help
	  Options passed by /etc/init.d/S95akwebrtc. Keep -f equal to
	  libpeer's VIDEO_FPS. Add -a for microphone audio and
	  -S stun:host:port when viewers are not on the camera's LAN.
	  Saved to /etc/default/akwebrtc, which can be edited on the
	  device.

endif
```

## package/anyka-av100-sdk/Config.in
```kconfig
config BR2_PACKAGE_ANYKA_AV100_SDK
	bool "anyka-av100-sdk"
	depends on BR2_arm
	help
	  Installs the closed-source media libraries, headers, kernel
	  modules, ISP/sensor configs and sensor load scripts from a local
	  copy of the AnyCloud39AV100 SDK (V1.12 or close to it).

	  The SDK is not redistributable, so it is not downloaded: point
	  BR2_PACKAGE_ANYKA_AV100_SDK_PATH at your copy. Run the SDK's own
	  ./auto_build.sh once first so the kernel modules exist.

if BR2_PACKAGE_ANYKA_AV100_SDK

config BR2_PACKAGE_ANYKA_AV100_SDK_PATH
	string "path to the AnyCloud39AV100 SDK"
	default "$(BR2_EXTERNAL_AKWEBRTC_PATH)/../AnyCloud39AV100_SDK_V1.12"
	help
	  Top of the SDK tree (the directory holding config.mk,
	  auto_build.sh, platform/ and rootfs/).

config BR2_PACKAGE_ANYKA_AV100_SDK_LIB_DIR
	string "media library directory, relative to the SDK"
	default "platform/lib"
	help
	  Where libplat_*.so, libmpi_*.so, libapp_video.so, libakmedia.so
	  and friends live in your SDK.

config BR2_PACKAGE_ANYKA_AV100_SDK_SENSOR
	string "sensor load script"
	default "gc4653"
	help
	  Name of the sensor script from rootfs/rootfs/usr/sbin of the SDK
	  (without .sh) run at boot to load ak_isp.ko and the sensor
	  driver, e.g. gc4653, gc2053, sc2336, sc3336, sc401ai.

config BR2_PACKAGE_ANYKA_AV100_SDK_ISP_CONF
	string "ISP config file"
	default "isp_gc4653_mipi_2lane_av100_hp.conf"
	help
	  ISP tuning file for the sensor, from rootfs/rootfs/etc of the
	  SDK. Linked to /etc/isp/isp.conf, which akwebrtc loads.

endif

comment "anyka-av100-sdk needs an ARM (ARM926EJ-S) target"
	depends on !BR2_arm
```

## package/libpeer/Config.in
```kconfig
config BR2_PACKAGE_LIBPEER
	bool "libpeer"
	depends on BR2_TOOLCHAIN_HAS_THREADS
	depends on !BR2_STATIC_LIBS
	help
	  Portable WebRTC (ICE, DTLS-SRTP, RTP, SCTP data channels) in C
	  for embedded devices. Builds its own copies of mbedTLS, libsrtp2
	  and cJSON and links them statically into libpeer.so.

	  https://github.com/sepfy/libpeer

if BR2_PACKAGE_LIBPEER

config BR2_PACKAGE_LIBPEER_VIDEO_FPS
	int "H.264 frame rate for RTP timestamps"
	default 15
	help
	  libpeer advances the H.264 RTP clock by 90000/FPS per frame,
	  so this must match the encoder frame rate (akwebrtc -f).

config BR2_PACKAGE_LIBPEER_USRSCTP
	bool "use usrsctp for data channels"
	help
	  Build usrsctp for full SCTP data channels. When disabled, libpeer
	  uses its built-in minimal SCTP, which is smaller and is all a
	  video-only camera needs.

config BR2_PACKAGE_LIBPEER_KEEPALIVE_MS
	int "STUN keepalive interval (ms)"
	default 5000
	help
	  Send a STUN binding request this often once connected. A viewer
	  that stops answering for 3 intervals is closed, which frees its
	  slot when a browser tab disappears without saying goodbye.
	  0 disables keepalives.

endif

comment "libpeer needs a toolchain w/ threads, dynamic library"
	depends on !BR2_TOOLCHAIN_HAS_THREADS || BR2_STATIC_LIBS
```
